## config/boards/shields/Kconfig.defconfig
```kconfig
if SHIELD_SPLITERGO_LEFT

config ZMK_KEYBOARD_NAME
    default "splitergo"

config ZMK_SPLIT_ROLE_CENTRAL
    default y

endif

if SHIELD_SPLITERGO_LEFT || SHIELD_SPLITERGO_RIGHT

    config ZMK_SPLIT
        default y

endif
```

## config/boards/shields/Kconfig.shield
```kconfig
config SHIELD_SPLITERGO_LEFT
    def_bool $(shields_list_contains, splitergo_left)

config SHIELD_SPLITERGO_RIGHT
    def_bool $(shields_list_contains, splitergo_right)
```
